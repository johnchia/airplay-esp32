## components/dac_tas58xx/Kconfig
```kconfig
if DAC_TAS58XX

    config TAS58XX_MAX_VOLUME
        int "Maximum DAC volume (dB)"
        range -100 0
        default -10
        help
            Maximum volume level in dB that corresponds to AirPlay volume 0 dB.
            The TAS5825M DIG_VOL register range is +24 dB to -103 dB.
            A value of -10 means AirPlay full volume maps to -10 dB on the DAC.

    config TAS58XX_PBTL
        bool "Amplifier outputs are bridged (PBTL mono)"
        default n
        help
            Bring the first amplifier up in parallel bridge-tied load (PBTL)
            mode, driving a single speaker from all four half-bridges. Only
            for a board that ties OUT_A+ to OUT_A- and OUT_B+ to OUT_B-, such
            as the Louder-ESP32-Mini. That wiring must never run as a stereo
            pair: each tied pair of half-bridges would be driven against
            each other.

            A bridged amplifier plays the left I2S channel, so the output
            channel mode defaults to mono (L+R) on such a board. The second
            amplifier of a dual-DAC board is bridged from the web interface
            instead.

endif # DAC_TAS58XX
```
